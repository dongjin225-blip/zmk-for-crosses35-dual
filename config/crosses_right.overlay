#include <zephyr/dt-bindings/input/input-event-codes.h>
#include <dt-bindings/zmk/input_transform.h>

&trackball_central {
    cpi = <1000>;
};

&zip_temp_layer {
    require-prior-idle-ms = <300>;
};

&trackball_central_listener {
    status = "okay";
    device = <&trackball_central>;
    input-processors = <
        &zip_ble_report_rate_limit
        &zip_temp_layer 3 2000
    >;
};
