#include <zephyr/dt-bindings/input/input-event-codes.h>
#include <dt-bindings/zmk/input_transform.h>

&trackball_peripheral {
    cpi = <1000>;
    x-invert;
    /delete-property/ y-invert;
};

/ {
    trackball_left_test_listener {
        compatible = "zmk,input-listener";
        device = <&trackball_peripheral>;
        input-processors = <&zip_ble_report_rate_limit>;
    };
};
